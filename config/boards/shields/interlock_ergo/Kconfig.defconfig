## config/boards/shields/interlock_ergo/Kconfig.shield
```kconfig
config SHIELD_INTERLOCK_ERGO_LEFT
    def_bool $(shields_list_contains,interlock_ergo_left)

config SHIELD_INTERLOCK_ERGO_RIGHT
    def_bool $(shields_list_contains,interlock_ergo_right)

config SHIELD_INTERLOCK_ERGO_DONGLE
    def_bool $(shields_list_contains,interlock_ergo_dongle)
```
