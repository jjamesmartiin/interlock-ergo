#include "interlock_ergo.dtsi"

/ {
    kscan0: kscan {
        compatible = "zmk,kscan-gpio-matrix";
        diode-direction = "col2row";
        row-gpios
            = <&pro_micro 4 (GPIO_ACTIVE_HIGH | GPIO_PULL_DOWN)>
            , <&pro_micro 5 (GPIO_ACTIVE_HIGH | GPIO_PULL_DOWN)>
            , <&pro_micro 6 (GPIO_ACTIVE_HIGH | GPIO_PULL_DOWN)>
            , <&pro_micro 7 (GPIO_ACTIVE_HIGH | GPIO_PULL_DOWN)>
            , <&pro_micro 8 (GPIO_ACTIVE_HIGH | GPIO_PULL_DOWN)>
            ;
        col-gpios
            = <&pro_micro 18 GPIO_ACTIVE_HIGH>  /* Col 0: Esc, Tab, Caps, Shift, Ctrl */
            , <&pro_micro 15 GPIO_ACTIVE_HIGH>  /* Col 1: 1, Q, A, Z, Gui */
            , <&pro_micro 14 GPIO_ACTIVE_HIGH>  /* Col 2: 2, W, S, X, Alt */
            , <&pro_micro 16 GPIO_ACTIVE_HIGH>  /* Col 3: 3, E, D, C, Space_L */
            , <&pro_micro 10 GPIO_ACTIVE_HIGH>  /* Col 4: 4, R, F, V (no bottom-row key) */
            , <&pro_micro 1 GPIO_ACTIVE_HIGH>   /* Col 5: 5, T, G, B, Fn */
            ;
    };
};
